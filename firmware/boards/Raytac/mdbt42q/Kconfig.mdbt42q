## firmware/boards/Raytac/mdbt42q/Kconfig.mdbt42q
```kconfig
config BOARD_MDBT42Q
	select SOC_NRF52832_QFAA if BOARD_MDBT42Q_NRF52832
	select SOC_NRF52811_QFAA if BOARD_MDBT42Q_NRF52811
	select SOC_NRF52810_QFAA if BOARD_MDBT42Q_NRF52810
```

## firmware/boards/Raytac/mdbt42q/board.yml
```yaml
board:
  name: mdbt42q
  vendor: Raytac
  socs:
    - name: nrf52832
    - name: nrf52811
    - name: nrf52810
```
